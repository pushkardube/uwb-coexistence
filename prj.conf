## CMakeLists.txt
```
cmake_minimum_required(VERSION 3.20)

set(BOARD decawave_dwm3001cdk)
set(DTS_ROOT ${CMAKE_CURRENT_SOURCE_DIR})
find_package(Zephyr REQUIRED HINTS $ENV{ZEPHYR_BASE})
project(dwm3001cdk_app)

target_sources(app PRIVATE
    src/main.c
)
```

## prj.conf
```kconfig
CONFIG_UART_CONSOLE=y
CONFIG_PRINTK=y
CONFIG_GPIO=y
CONFIG_LOG=y
CONFIG_LOG_DEFAULT_LEVEL=3
CONFIG_LOG_MODE_IMMEDIATE=y
CONFIG_MAIN_STACK_SIZE=4096
```

## src/main.c
```c
/*
 * Minimal sanity-check app for the DWM3001CDK board.
 *
 * Blinks led0 (D9 green LED) and logs a heartbeat over the console UART.
 * Use this to confirm the toolchain, board files and flashing setup work
 * before building anything that touches the DW3000 radio.
 */

#include <zephyr/kernel.h>
#include <zephyr/device.h>
#include <zephyr/devicetree.h>
#include <zephyr/drivers/gpio.h>
#include <zephyr/logging/log.h>

LOG_MODULE_REGISTER(main, LOG_LEVEL_INF);

#define LED0_NODE DT_ALIAS(led0)

static const struct gpio_dt_spec led0 = GPIO_DT_SPEC_GET(LED0_NODE, gpios);

int main(void)
{
    LOG_INF("DWM3001CDK app boot");

    if (!gpio_is_ready_dt(&led0)) {
        LOG_ERR("led0 device not ready");
        return -1;
    }

    int ret = gpio_pin_configure_dt(&led0, GPIO_OUTPUT_ACTIVE);
    if (ret < 0) {
        LOG_ERR("failed to configure led0 (%d)", ret);
        return ret;
    }

    while (1) {
        gpio_pin_toggle_dt(&led0);
        LOG_INF("heartbeat");
        k_sleep(K_MSEC(500));
    }

    return 0;
}
```
