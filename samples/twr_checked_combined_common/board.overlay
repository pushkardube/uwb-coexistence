// Checked samples: omit invalid optional GPIO1.19 wakeup mapping.
// Use existing HAL chip-select wakeup fallback; no sleep mode is used.
// SPI property defined cause UWB module uses SPI connection

&spi3 {
    dwm3000: dw3000@0 {
        compatible = "qorvo,dw3000";
        spi-max-frequency = <32000000>;
        status = "okay";
        reg = <0>;
        reset-gpios = <&gpio0 25 GPIO_ACTIVE_LOW>;
        irq-gpios = <&gpio1 2 GPIO_ACTIVE_HIGH>;
        cs-gpios = <&gpio1 6 GPIO_ACTIVE_LOW>;
    };
};